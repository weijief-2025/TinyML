#include <TensorFlowLite.h>
#include "network_model.h"
#include "tensorflow/lite/micro/kernels/micro_ops.h"
#include "tensorflow/lite/micro/micro_error_reporter.h"
#include "tensorflow/lite/micro/micro_interpreter.h"
#include "tensorflow/lite/micro/micro_mutable_op_resolver.h"
#include "tensorflow/lite/schema/schema_generated.h"
#include "tensorflow/lite/version.h"

#define NUMBER_OF_INPUTS 38
#define NUMBER_OF_OUTPUTS 2
#define NUMBER_OF_SAMPLES 10
#define TENSOR_ARENA_SIZE 16*1024

uint8_t tensor_arena[TENSOR_ARENA_SIZE];
tflite::ErrorReporter* error_reporter;
tflite::MicroInterpreter* interpreter;
TfLiteTensor* input;
TfLiteTensor* output;

const float X_test[NUMBER_OF_SAMPLES][NUMBER_OF_INPUTS] = {
    -0.11084689516941944, -0.12285242341578878, 1.0896183371528936,
    -2.22571903413647, -0.007750926370341471, -0.006261883325402098,
    -0.08981266848602212, -0.09560133107662426, -0.8103630061515018,
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    -0.37609230678856703, -0.648768477722399
};

const uint8_t y_test[NUMBER_OF_SAMPLES] = {
    0, 1, 0, 1, 0, 0, 0, 1, 0, 1
};

const char* className(uint8_t class_id) {
    return class_id == 0 ? "attack" : "normal";
}

void setup() {
    Serial.begin(115200);
    static tflite::MicroErrorReporter micro_error_reporter;
    error_reporter = &micro_error_reporter;

    const tflite::Model* model = tflite::GetModel(network_model);
    if (model->version() != TFLITE_SCHEMA_VERSION) {
        Serial.println("Model version does not match schema version.");
        return;
    }

    static tflite::MicroMutableOpResolver<10> micro_op_resolver;
    micro_op_resolver.AddFullyConnected();
    micro_op_resolver.AddSoftmax();
    micro_op_resolver.AddQuantize();
    micro_op_resolver.AddDequantize();

    static tflite::MicroInterpreter static_interpreter(model, micro_op_resolver, tensor_arena, TENSOR_ARENA_SIZE, error_reporter);
    interpreter = &static_interpreter;

    if (interpreter->AllocateTensors() != kTfLiteOk) {
        Serial.println("Failed to allocate tensors!");
        return;
    }

    input = interpreter->input(0);
    output = interpreter->output(0);
}

void loop() {
    for (uint8_t i = 0; i < NUMBER_OF_SAMPLES; i++) {
        for (int j = 0; j < NUMBER_OF_INPUTS; j++) {
            input->data.f[j] = X_test[i][j];
        }

        if (interpreter->Invoke() != kTfLiteOk) {
            Serial.println("Failed to invoke!");
            continue;
        }

        float attack_score = output->data.f[0];
        float normal_score = output->data.f[1];
        int predicted_class = attack_score > normal_score ? 0 : 1;

        Serial.print("Sample #");
        Serial.print(i + 1);
        Serial.print(" | Predicted Class: ");
        Serial.print(predicted_class);
        Serial.print(" (");
        Serial.print(className(predicted_class));
        Serial.print(") | Actual Class: ");
        Serial.print(y_test[i]);
        Serial.print(" (");
        Serial.print(className(y_test[i]));
        Serial.print(") | attack_score: ");
        Serial.print(attack_score, 6);
        Serial.print(" | normal_score: ");
        Serial.println(normal_score, 6);

        delay(1000);
    }

    delay(10000);
}
